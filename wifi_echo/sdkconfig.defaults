## wifi_echo_micro_ros/main/Kconfig.projbuild
```kconfig
menu "micro-ROS app settings"

    config MICRO_ROS_APP_STACK
        int "micro-ROS 任务栈大小 (Bytes)"
        default 16000

    config MICRO_ROS_APP_TASK_PRIO
        int "micro-ROS 任务优先级"
        default 5

endmenu
```

## wifi_echo_micro_ros/sdkconfig.defaults
```kconfig
# micro-ROS WiFi STA 配置
# WiFi 凭据和 Agent 地址通过 micro-ROS Kconfig 设置

# micro-ROS 中间件
CONFIG_MICRO_ROS_ESP_XRCE_DDS_MIDDLEWARE=y

# 使用 WiFi 网络接口
CONFIG_MICRO_ROS_ESP_NETIF_WLAN=y

# WiFi STA 凭据 (连接 Ubuntu 热点)
CONFIG_ESP_WIFI_SSID="Ubuntu-ROS"
CONFIG_ESP_WIFI_PASSWORD="ros2ctrl"

# micro-ROS Agent 地址
CONFIG_MICRO_ROS_AGENT_IP="192.168.100.1"
CONFIG_MICRO_ROS_AGENT_PORT="8888"

# micro-ROS 任务配置
CONFIG_MICRO_ROS_APP_STACK=16384
CONFIG_MICRO_ROS_APP_TASK_PRIO=5

# 分区表 (micro-ROS 固件较大)
CONFIG_PARTITION_TABLE_SINGLE_APP_LARGE=y

# 主任务栈
CONFIG_ESP_MAIN_TASK_STACK_SIZE=8192

# LWIP: 增大 UDP 接收邮箱 (默认 6 太小, XRCE-DDS 突发包容易丢)
CONFIG_LWIP_UDP_RECVMBOX_SIZE=32
```
